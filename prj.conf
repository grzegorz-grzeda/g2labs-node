## CMakeLists.txt
```
# SPDX-License-Identifier: MIT
cmake_minimum_required(VERSION 3.20.0)
find_package(Zephyr REQUIRED HINTS $ENV{ZEPHYR_BASE})
project(g2labs_node)

include(${CMAKE_CURRENT_SOURCE_DIR}/core/core.cmake)

target_sources(app PRIVATE
  src/main.c
  src/shell.c
  src/adapters/image_mcuboot.c
  src/adapters/memory.c
  src/adapters/mqtt.c
  src/adapters/settings.c
  src/adapters/smp.c
  src/adapters/system.c
  src/adapters/watchdog.c
  src/adapters/wifi.c
)
```

## Kconfig
```
# SPDX-License-Identifier: MIT

menu "g2labs-node"

config NODE_BROKER_FAILOVER_S
	int "Seconds the Broker may be unreachable before moving network"
	default 300
	range 60 3600
	help
	  How long the Node keeps retrying the Broker on the current Known
	  Network before it rescans and moves to the strongest other one.
	  Shorter outages only reconnect on the same network; with a single
	  Known Network the Node stays on it.

config NODE_WATCHDOG_TIMEOUT_S
	int "Seconds the main loop may stall before the watchdog resets"
	default 30
	range 5 600
	help
	  The main loop feeds the hardware watchdog at least once a second.
	  If it stalls for this long, the Node resets (the ESP32 driver
	  interrupts after one timeout and resets after a second, so after
	  twice this); an image that hasn't reached the
	  Broker yet, and so isn't confirmed, is then reverted by MCUboot.

endmenu

source "Kconfig.zephyr"
```

## sysbuild.conf
```
# Boot the Node under MCUboot, signed with MCUboot's development key.
SB_CONFIG_BOOTLOADER_MCUBOOT=y
```

## prj.conf
```kconfig
CONFIG_LOG=y

# UART shell
CONFIG_SHELL=y
# Diagnostics on the shell: `node status`'s reset cause, and Zephyr's `net`
# (iface, ping, dns, arp) and `kernel` (threads, stacks, uptime, reboot)
# commands. Not the Wi-Fi shell: `wifi connect` would bypass the core and
# fight the Known Network failover.
CONFIG_HWINFO=y
CONFIG_NET_SHELL=y
CONFIG_NET_L2_WIFI_SHELL=n
CONFIG_KERNEL_SHELL=y
CONFIG_THREAD_MONITOR=y
CONFIG_THREAD_NAME=y
CONFIG_THREAD_STACK_INFO=y
CONFIG_INIT_STACKS=y

# Image adapter: confirm the running MCUboot image
CONFIG_FLASH=y
CONFIG_FLASH_MAP=y
CONFIG_STREAM_FLASH=y
CONFIG_IMG_MANAGER=y
CONFIG_MCUBOOT_IMG_MANAGER=y

# Settings: Known Networks in the storage partition
CONFIG_NVS=y
CONFIG_SETTINGS=y

# Wi-Fi station with DHCP
CONFIG_NETWORKING=y
CONFIG_NET_IPV4=y
CONFIG_NET_IPV6=n
CONFIG_NET_DHCPV4=y
# The Wi-Fi adapter runs DHCP itself, so association and getting an IP
# address reach the core as separate events.
CONFIG_WIFI_STA_AUTO_DHCPV4=n
CONFIG_NET_TCP=y
CONFIG_WIFI=y
CONFIG_NET_L2_WIFI_MGMT=y
CONFIG_NET_MGMT=y
CONFIG_NET_MGMT_EVENT=y
CONFIG_NET_MGMT_EVENT_INFO=y
CONFIG_NET_MGMT_EVENT_QUEUE_SIZE=16
CONFIG_ESP32_WIFI_ENABLE_WPA3_SAE=y

# Broker: MQTT 3.1.1 over plain TCP. Host names resolve via DHCP's DNS
# server, and .local names via mDNS (the resolver joins the mDNS group).
CONFIG_NET_SOCKETS=y
CONFIG_DNS_RESOLVER=y
CONFIG_MDNS_RESOLVER=y
# The resolver adds the mDNS group only with static servers enabled; none
# are set, so unicast DNS still comes from DHCP alone.
CONFIG_DNS_SERVER_IP_ADDRESSES=y
CONFIG_NET_IPV4_IGMP=y
CONFIG_MQTT_LIB=y

# mDNS name g2labs-<node-id>.local (docs/mqtt.md). The unique postfix is the
# interface's link address in lowercase hex, the Wi-Fi MAC the Node ID comes
# from, so the hostname is "g2labs-" followed by the Node ID (main.c logs an
# error if it isn't). The responder answers with whatever IPv4 address the
# interface has when asked, and the IPv4 stack rejoins the mDNS group when
# the interface comes up again, so the name follows the Node to another
# Known Network. Without probing (experimental) it doesn't announce the new
# address; a querier's cache may hold the old one for up to the TTL.
CONFIG_NET_HOSTNAME_ENABLE=y
CONFIG_NET_HOSTNAME="g2labs-"
CONFIG_NET_HOSTNAME_UNIQUE=y
CONFIG_MDNS_RESPONDER=y

# Reboot command
CONFIG_REBOOT=y

# Hardware watchdog, fed by the main loop: a hung Node resets, and an
# unconfirmed image is then reverted by MCUboot
CONFIG_WATCHDOG=y

# Free memory in status: runtime stats of every sys_heap
CONFIG_SYS_HEAP_RUNTIME_STATS=y
CONFIG_SYS_HEAP_ARRAY_SIZE=4

CONFIG_MAIN_STACK_SIZE=4096
CONFIG_SHELL_STACK_SIZE=4096

# Remote management: SMP over UDP port 1337 on every interface, listening
# from the moment the Node has an IP address. Unauthenticated until the
# security work (docs/management.md).
CONFIG_NET_UDP=y
CONFIG_MCUMGR=y
CONFIG_ZCBOR=y
CONFIG_CRC=y
CONFIG_NET_BUF=y
CONFIG_MCUMGR_TRANSPORT_UDP=y
# Connections: DHCP, the DNS and mDNS resolver sockets, MQTT, SMP and the
# mDNS responder, plus one spare. At the default of 4 the resolver lost its
# mDNS socket and .local Brokers stopped resolving.
CONFIG_NET_MAX_CONN=7
CONFIG_NET_MAX_CONTEXTS=8
# The DNS resolver and the mDNS responder share the socket service thread,
# which with both has 4 entries to poll. At the default of 3 the thread
# doesn't start, the resolver can't register and no Broker host name
# resolves, .local or not.
CONFIG_ZVFS_POLL_MAX=4
CONFIG_MCUMGR_TRANSPORT_WORKQUEUE_STACK_SIZE=4096
# Image management: upload to the secondary slot, test, confirm, list
CONFIG_MCUMGR_GRP_IMG=y
# OS management: echo, reset, buffer parameters and bootloader info for
# host tools that size their uploads from them
CONFIG_MCUMGR_GRP_OS=y
CONFIG_MCUMGR_GRP_OS_MCUMGR_PARAMS=y
CONFIG_MCUMGR_GRP_OS_BOOTLOADER_INFO=y
# Shell management: run `node …` commands over SMP. No devmem: it would
# read any memory, passwords included, for anyone on the network.
CONFIG_DEVMEM_SHELL=n
CONFIG_SHELL_BACKEND_DUMMY=y
CONFIG_SHELL_BACKEND_DUMMY_BUF_SIZE=1024
CONFIG_MCUMGR_GRP_SHELL=y
# Settings management, through the settings adapter's "node" handler. The
# access hook refuses password reads and deletes under node/.
CONFIG_SETTINGS_RUNTIME=y
CONFIG_MCUMGR_GRP_SETTINGS=y
CONFIG_MCUMGR_GRP_SETTINGS_NAME_LEN=32
CONFIG_MCUMGR_GRP_SETTINGS_VALUE_LEN=65
CONFIG_MCUMGR_MGMT_NOTIFICATION_HOOKS=y
CONFIG_MCUMGR_GRP_SETTINGS_ACCESS_HOOK=y
```

## src/main.c
```c
/* SPDX-License-Identifier: MIT */
#include <string.h>

#include <zephyr/app_version.h>
#include <zephyr/kernel.h>
#include <zephyr/logging/log.h>

#include <node/core.h>

#include "adapters/adapters.h"
#include "app.h"

LOG_MODULE_REGISTER(main, LOG_LEVEL_INF);

#define EVENT_QUEUE_LEN 64
/* The core is told the time at least this often, for its timeouts. */
#define TICK_PERIOD     K_SECONDS(1)

static const struct node_ports ports = {
	.ctx = NULL,
	.mqtt_connect = mqtt_adapter_connect,
	.mqtt_disconnect = mqtt_adapter_disconnect,
	.mqtt_publish = mqtt_adapter_publish,
	.mqtt_subscribe_commands = mqtt_adapter_subscribe_commands,
	.wifi_rssi = wifi_adapter_rssi,
	.wifi_ipv4 = wifi_adapter_ipv4,
	.free_memory = memory_adapter_free,
	.wifi_scan = wifi_adapter_scan,
	.wifi_connect = wifi_adapter_connect,
	.wifi_disconnect = wifi_adapter_disconnect,
	.image_confirm = image_adapter_confirm,
	.reboot = system_adapter_reboot,
	.log_warning = system_adapter_log_warning,
};

static struct node_core core;
static K_MUTEX_DEFINE(core_lock);
K_MSGQ_DEFINE(event_queue, sizeof(struct node_event), EVENT_QUEUE_LEN, 4);

struct node_core *app_core_lock(void)
{
	k_mutex_lock(&core_lock, K_FOREVER);
	return &core;
}

void app_core_unlock(void)
{
	k_mutex_unlock(&core_lock);
}

void app_post_event(const struct node_event *event)
{
	/*
	 * Scan results may be dropped when a scan floods the queue. Commands are
	 * dropped too: the MQTT adapter posts them holding its client lock, which
	 * the core may be waiting for. Every other event changes the core's
	 * state, so wait for room.
	 */
	bool droppable = event->type == NODE_EVENT_WIFI_NETWORK_HEARD ||
			 event->type == NODE_EVENT_COMMAND;

	if (k_msgq_put(&event_queue, event, droppable ? K_NO_WAIT : K_FOREVER) != 0) {
		if (event->type == NODE_EVENT_COMMAND) {
			LOG_WRN("event queue full, dropped a command");
		} else {
			LOG_DBG("event queue full, dropped scan result");
		}
	}
}

int main(void)
{
	struct node_info info = {
		/* SemVer 2.0.0 without build metadata (VERSION_TWEAK is MCUboot's only). */
		.fw_version = APP_VERSION_STRING,
		/* Neither board has a revision, so this is the plain board target. */
		.board = CONFIG_BOARD_TARGET,
		.broker_failover_ms = CONFIG_NODE_BROKER_FAILOVER_S * 1000U,
	};
	struct node_event event;

	/* First, so a hang anywhere from here on resets the Node. */
	watchdog_adapter_init(CONFIG_NODE_WATCHDOG_TIMEOUT_S * 1000U);

	if (wifi_adapter_mac(info.mac) != 0) {
		LOG_ERR("no Wi-Fi MAC address; the Node ID will be all zeros");
	}
	wifi_adapter_init();
	smp_adapter_init();

	app_core_lock();
	node_core_init(&core, &ports, &info);
	settings_adapter_load(&core);
	node_core_tick(&core, k_uptime_get());
	node_core_start(&core);
	app_core_unlock();

	LOG_INF("g2labs-node %s started, Node ID %s", info.fw_version, node_core_id(&core));

	/* Zephyr takes the hostname's postfix from the first interface to set a
	 * link address; a second interface could make it another MAC's.
	 */
	char mdns_name[WIFI_ADAPTER_MDNS_NAME_SIZE] = "";

	if (wifi_adapter_mdns_name(mdns_name, sizeof(mdns_name)) != 0 ||
	    strstr(mdns_name, node_core_id(&core)) == NULL) {
		LOG_ERR("mDNS name %s doesn't carry the Node ID", mdns_name);
	} else {
		LOG_INF("mDNS name %s", mdns_name);
	}

	while (true) {
		bool have_event = k_msgq_get(&event_queue, &event, TICK_PERIOD) == 0;

		app_core_lock();
		node_core_tick(&core, k_uptime_get());
		if (have_event) {
			node_core_handle_event(&core, &event);
		}
		app_core_unlock();
		/* The core got through another turn, so the Node isn't hung. */
		watchdog_adapter_feed();
	}
	return 0;
}
```

## src/app.h
```c
/* SPDX-License-Identifier: MIT */
#ifndef NODE_APP_H
#define NODE_APP_H

#include <node/core.h>

/*
 * The running Node core. The core isn't thread-safe: management surfaces such
 * as the shell must hold it with app_core_lock() / app_core_unlock().
 */
struct node_core *app_core_lock(void);
void app_core_unlock(void);

/* Queue a platform event for the core; safe from any thread. */
void app_post_event(const struct node_event *event);

#endif /* NODE_APP_H */
```

## src/shell.c
```c
/* SPDX-License-Identifier: MIT */
#include <errno.h>
#include <stdio.h>
#include <stdlib.h>
#include <string.h>

#include <zephyr/kernel.h>
#include <zephyr/net/net_ip.h>

#include <zephyr/shell/shell.h>

#include <node/core.h>

#include "adapters/adapters.h"
#include "app.h"

static int cmd_node_version(const struct shell *sh, size_t argc, char **argv)
{
	ARG_UNUSED(argc);
	ARG_UNUSED(argv);

	struct node_core *core = app_core_lock();

	shell_print(sh, "%s", node_core_fw_version(core));
	app_core_unlock();
	return 0;
}

/* Persist the Known Networks after a change and tell the installer when it applies. */
static int save_and_report(const struct shell *sh, const struct node_core *core, const char *done)
{
	int err = settings_adapter_save_known_networks(core);

	if (err) {
		shell_error(sh, "%s, but saving to flash failed (%d); it is lost on reboot", done,
			    err);
		return err;
	}
	shell_print(sh, "%s", done);
	return 0;
}

static int cmd_network_add(const struct shell *sh, size_t argc, char **argv)
{
	const char *ssid = argv[1];
	const char *password = argc > 2 ? argv[2] : "";
	char done[64 + NODE_SSID_MAX_LEN];
	struct node_core *core = app_core_lock();
	int err = node_core_add_known_network(core, ssid, password);

	if (err == 0) {
		snprintf(done, sizeof(done), "Known Network \"%s\" saved", ssid);
		err = save_and_report(sh, core, done);
		if (node_core_current_network(core) != NULL) {
			shell_print(sh, "The Node stays on its current network while it is healthy");
		}
	} else if (err == -ENOSPC) {
		shell_error(sh, "Already %d Known Networks, the limit; remove one first",
			    NODE_KNOWN_NETWORKS_MAX);
	} else if (err == -EINVAL) {
		shell_error(sh, "SSID must be 1-%d bytes; password empty (open network), "
				"%d-%d characters, or a %d hex digit key",
			    NODE_SSID_MAX_LEN, NODE_PASSWORD_MIN_LEN, NODE_PASSWORD_MAX_LEN - 1,
			    NODE_PASSWORD_MAX_LEN);
	} else {
		shell_error(sh, "Adding Known Network failed (%d)", err);
	}
	app_core_unlock();
	return err;
}

static int cmd_network_remove(const struct shell *sh, size_t argc, char **argv)
{
	ARG_UNUSED(argc);

	const char *ssid = argv[1];
	char done[64 + NODE_SSID_MAX_LEN];
	struct node_core *core = app_core_lock();
	const char *current = node_core_current_network(core);
	bool on_it = current != NULL && strcmp(current, ssid) == 0;
	int err = node_core_remove_known_network(core, ssid);

	if (err == 0) {
		snprintf(done, sizeof(done), "Known Network \"%s\" removed", ssid);
		err = save_and_report(sh, core, done);
		if (on_it) {
			shell_print(sh, "The Node stays on it until the link drops or it reboots");
		}
	} else {
		shell_error(sh, "No Known Network \"%s\"", ssid);
	}
	app_core_unlock();
	return err;
}

static int cmd_network_list(const struct shell *sh, size_t argc, char **argv)
{
	ARG_UNUSED(argc);
	ARG_UNUSED(argv);

	struct node_core *core = app_core_lock();
	size_t count = node_core_known_network_count(core);

	/* Passwords are never shown, only whether a network has one. */
	for (size_t i = 0; i < count; i++) {
		const struct node_known_network *kn = node_core_known_network(core, i);

		shell_print(sh, "%zu: %s (%s)", i + 1, kn->ssid,
			    kn->password[0] != '\0' ? "password set" : "open");
	}
	shell_print(sh, "%zu of %d Known Networks", count, NODE_KNOWN_NETWORKS_MAX);
	app_core_unlock();
	return 0;
}

static int cmd_network_status(const struct shell *sh, size_t argc, char **argv)
{
	ARG_UNUSED(argc);
	ARG_UNUSED(argv);

	char current[NODE_SSID_MAX_LEN + 1] = "";
	struct node_core *core = app_core_lock();
	const char *ssid = node_core_current_network(core);

	if (ssid != NULL) {
		strcpy(current, ssid);
	}
	app_core_unlock();

	if (current[0] == '\0') {
		shell_print(sh, "Offline");
		return 0;
	}

	int rssi;
	char ip[NET_IPV4_ADDR_LEN];
	int err = wifi_adapter_link_info(&rssi, ip, sizeof(ip));

	shell_print(sh, "Network: %s", current);
	if (err) {
		shell_print(sh, "RSSI and IP address unavailable (%d)", err);
	} else {
		shell_print(sh, "RSSI: %d dBm", rssi);
		shell_print(sh, "IP address: %s", ip);
	}
	return 0;
}

static int cmd_node_id(const struct shell *sh, size_t argc, char **argv)
{
	ARG_UNUSED(argc);
	ARG_UNUSED(argv);

	char mdns_name[WIFI_ADAPTER_MDNS_NAME_SIZE];
	struct node_core *core = app_core_lock();
	const char *name = node_core_friendly_name(core);

	shell_print(sh, "Node ID: %s", node_core_id(core));
	shell_print(sh, "Friendly name: %s", name[0] != '\0' ? name : "(none)");
	app_core_unlock();
	if (wifi_adapter_mdns_name(mdns_name, sizeof(mdns_name)) == 0) {
		shell_print(sh, "mDNS name: %s", mdns_name);
	}
	return 0;
}

static int set_friendly_name(const struct shell *sh, const char *name)
{
	struct node_core *core = app_core_lock();
	int err = node_core_set_friendly_name(core, name);

	if (err) {
		shell_error(sh, "The friendly name must be at most %d bytes",
			    NODE_FRIENDLY_NAME_MAX_LEN);
	} else if ((err = settings_adapter_save_friendly_name(core)) != 0) {
		shell_error(sh, "Friendly name set, but saving to flash failed (%d); "
				"it is lost on reboot", err);
	} else {
		shell_print(sh, "Friendly name %s; status reports it from the next message",
			    name[0] != '\0' ? "saved" : "cleared");
	}
	app_core_unlock();
	return err;
}

static int cmd_name_set(const struct shell *sh, size_t argc, char **argv)
{
	ARG_UNUSED(argc);

	return set_friendly_name(sh, argv[1]);
}

static int cmd_name_clear(const struct shell *sh, size_t argc, char **argv)
{
	ARG_UNUSED(argc);
	ARG_UNUSED(argv);

	return set_friendly_name(sh, "");
}

/* Apply changed Broker settings, persist them and say when they take effect. */
static int apply_broker(const struct shell *sh, struct node_core *core,
			const struct node_broker *broker)
{
	int err = node_core_set_broker(core, broker);

	if (err) {
		shell_error(sh, "A password needs a username; set one with: node broker login "
				"<username> <password>");
		return err;
	}
	err = settings_adapter_save_broker(core);
	if (err) {
		shell_error(sh, "Broker settings applied, but saving to flash failed (%d); "
				"they are lost on reboot", err);
		return err;
	}
	shell_print(sh, "Broker settings saved");
	if (broker->host[0] == '\0') {
		shell_print(sh, "No Broker: the Node stays off MQTT");
	} else if (node_core_current_network(core) != NULL) {
		shell_print(sh, "Reconnecting to the Broker with the new settings");
	} else {
		shell_print(sh, "They apply once the Node is on a Known Network");
	}
	return 0;
}

static int cmd_broker_set(const struct shell *sh, size_t argc, char **argv)
{
	unsigned long port = NODE_BROKER_DEFAULT_PORT;

	if (argc > 2) {
		char *end;

		port = strtoul(argv[2], &end, 10);
		if (*end != '\0' || port == 0 || port > UINT16_MAX) {
			shell_error(sh, "Port must be 1-%u", UINT16_MAX);
			return -EINVAL;
		}
	}
	if (strlen(argv[1]) > NODE_BROKER_HOST_MAX_LEN) {
		shell_error(sh, "Host must be at most %d bytes", NODE_BROKER_HOST_MAX_LEN);
		return -EINVAL;
	}

	struct node_core *core = app_core_lock();
	struct node_broker broker = *node_core_broker(core);

	strcpy(broker.host, argv[1]);
	broker.port = (uint16_t)port;
	int err = apply_broker(sh, core, &broker);

	app_core_unlock();
	return err;
}

static int cmd_broker_login(const struct shell *sh, size_t argc, char **argv)
{
	const char *username = argv[1];
	const char *password = argc > 2 ? argv[2] : "";

	if (strlen(username) > NODE_BROKER_USERNAME_MAX_LEN ||
	    strlen(password) > NODE_BROKER_PASSWORD_MAX_LEN) {
		shell_error(sh, "Username must be at most %d bytes, password at most %d",
			    NODE_BROKER_USERNAME_MAX_LEN, NODE_BROKER_PASSWORD_MAX_LEN);
		return -EINVAL;
	}

	struct node_core *core = app_core_lock();
	struct node_broker broker = *node_core_broker(core);

	strcpy(broker.username, username);
	strcpy(broker.password, password);
	int err = apply_broker(sh, core, &broker);

	app_core_unlock();
	return err;
}

static int cmd_broker_logout(const struct shell *sh, size_t argc, char **argv)
{
	ARG_UNUSED(argc);
	ARG_UNUSED(argv);

	struct node_core *core = app_core_lock();
	struct node_broker broker = *node_core_broker(core);

	broker.username[0] = '\0';
	broker.password[0] = '\0';
	int err = apply_broker(sh, core, &broker);

	app_core_unlock();
	return err;
}

static int cmd_broker_clear(const struct shell *sh, size_t argc, char **argv)
{
	ARG_UNUSED(argc);
	ARG_UNUSED(argv);

	struct node_core *core = app_core_lock();
	const struct node_broker broker = {.port = NODE_BROKER_DEFAULT_PORT};
	int err = apply_broker(sh, core, &broker);

	app_core_unlock();
	return err;
}

static int cmd_broker_show(const struct shell *sh, size_t argc, char **argv)
{
	ARG_UNUSED(argc);
	ARG_UNUSED(argv);

	struct node_core *core = app_core_lock();
	const struct node_broker *b = node_core_broker(core);

	if (b->host[0] == '\0') {
		shell_print(sh, "No Broker set");
	} else {
		shell_print(sh, "Broker: %s:%u", b->host, b->port);
		/* The password is never shown, only whether there is one. */
		if (b->username[0] != '\0') {
			shell_print(sh, "Username: %s (%s)", b->username,
				    b->password[0] != '\0' ? "password set" : "no password");
		} else {
			shell_print(sh, "Anonymous");
		}
		shell_print(sh, "%s", node_core_broker_connected(core) ? "Connected"
								      : "Not connected");
	}
	app_core_unlock();
	return 0;
}

/* A duration as "3d 2h 13m 05s", leaving out leading zero units. */
static void format_duration(char *buf, size_t len, int64_t ms)
{
	int64_t s = ms / 1000;
	int days = (int)(s / 86400);
	int hours = (int)(s / 3600 % 24);
	int minutes = (int)(s / 60 % 60);
	int seconds = (int)(s % 60);

	if (days > 0) {
		snprintf(buf, len, "%dd %dh %02dm %02ds", days, hours, minutes, seconds);
	} else if (hours > 0) {
		snprintf(buf, len, "%dh %02dm %02ds", hours, minutes, seconds);
	} else if (minutes > 0) {
		snprintf(buf, len, "%dm %02ds", minutes, seconds);
	} else {
		snprintf(buf, len, "%ds", seconds);
	}
}

static void print_wifi(const struct shell *sh, enum node_wifi_state wifi, const char *ssid)
{
	uint8_t mac[NODE_MAC_LEN];
	char mac_str[3 * NODE_MAC_LEN] = "unknown";

	if (wifi_adapter_mac(mac) == 0) {
		snprintf(mac_str, sizeof(mac_str), "%02x:%02x:%02x:%02x:%02x:%02x", mac[0],
			 mac[1], mac[2], mac[3], mac[4], mac[5]);
	}

	switch (wifi) {
	case NODE_WIFI_IDLE:
		shell_print(sh, "Wi-Fi: offline  MAC %s", mac_str);
		return;
	case NODE_WIFI_SCANNING:
		shell_print(sh, "Wi-Fi: scanning  MAC %s", mac_str);
		return;
	case NODE_WIFI_JOINING:
		shell_print(sh, "Wi-Fi: joining %s  MAC %s", ssid, mac_str);
		return;
	case NODE_WIFI_AWAITING_IP:
		shell_print(sh, "Wi-Fi: on %s, waiting for an IP address  MAC %s", ssid, mac_str);
		return;
	case NODE_WIFI_JOIN_RETRY_WAIT:
		shell_print(sh, "Wi-Fi: join of %s failed, retrying  MAC %s", ssid, mac_str);
		return;
	case NODE_WIFI_CONNECTED:
		break;
	}

	int rssi;
	char ip[NET_IPV4_ADDR_LEN];

	if (wifi_adapter_link_info(&rssi, ip, sizeof(ip)) == 0) {
		shell_print(sh, "Wi-Fi: on %s  RSSI %d dBm  IP %s  MAC %s", ssid, rssi, ip,
			    mac_str);
	} else {
		shell_print(sh, "Wi-Fi: on %s  RSSI and IP unavailable  MAC %s", ssid, mac_str);
	}
}

static void print_broker(const struct shell *sh, const struct node_broker *b,
			 const struct node_state *st)
{
	char took[32];
	char left[32];

	if (b->host[0] == '\0') {
		shell_print(sh, "Broker: none set");
		return;
	}
	switch (st->broker) {
	case NODE_BROKER_IDLE:
		shell_print(sh, "Broker: %s:%u, not connecting", b->host, b->port);
		break;
	case NODE_BROKER_CONNECTED:
		format_duration(took, sizeof(took), st->broker_connected_ms);
		shell_print(sh, "Broker: %s:%u connected %s", b->host, b->port, took);
		break;
	case NODE_BROKER_CONNECTING:
	case NODE_BROKER_RETRY_WAIT:
		if (st->broker == NODE_BROKER_CONNECTING && st->broker_unreachable_ms < 1000) {
			shell_print(sh, "Broker: %s:%u connecting", b->host, b->port);
			break;
		}
		format_duration(took, sizeof(took), st->broker_unreachable_ms);
		if (st->failover_in_ms >= 0) {
			format_duration(left, sizeof(left), st->failover_in_ms);
			shell_print(sh, "Broker: %s:%u unreachable %s, next Known Network in %s",
				    b->host, b->port, took, left);
		} else {
			shell_print(sh, "Broker: %s:%u unreachable %s", b->host, b->port, took);
		}
		break;
	}
}

static int cmd_node_status(const struct shell *sh, size_t argc, char **argv)
{
	ARG_UNUSED(argc);
	ARG_UNUSED(argv);

	char id[NODE_ID_LEN + 1];
	char name[NODE_FRIENDLY_NAME_MAX_LEN + 1];
	char ssid[NODE_SSID_MAX_LEN + 1];
	char version[32];
	struct node_broker broker;
	struct node_state st;
	struct node_core *core = app_core_lock();

	node_core_state(core, &st);
	snprintf(id, sizeof(id), "%s", node_core_id(core));
	snprintf(name, sizeof(name), "%s", node_core_friendly_name(core));
	snprintf(ssid, sizeof(ssid), "%s", st.ssid);
	snprintf(version, sizeof(version), "%s", node_core_fw_version(core));
	broker = *node_core_broker(core);
	app_core_unlock();
	memset(broker.password, 0, sizeof(broker.password));

	char mdns_name[WIFI_ADAPTER_MDNS_NAME_SIZE] = "unknown";
	char uptime[32];
	struct image_adapter_slot slots[IMAGE_ADAPTER_SLOTS];
	size_t count = image_adapter_list(slots);
	const struct image_adapter_slot *running = NULL;

	(void)wifi_adapter_mdns_name(mdns_name, sizeof(mdns_name));
	format_duration(uptime, sizeof(uptime), k_uptime_get());
	for (size_t i = 0; i < count; i++) {
		if (slots[i].active) {
			running = &slots[i];
		}
	}

	shell_print(sh, "Version: %s (%s)", version, CONFIG_BOARD_TARGET);
	shell_print(sh, "Node ID: %s  name: %s  mDNS: %s", id, name[0] != '\0' ? name : "(none)",
		    mdns_name);
	shell_print(sh, "Uptime: %s  last reset: %s", uptime, system_adapter_reset_cause());
	shell_print(sh, "Free heap: %zu B", memory_adapter_free(NULL));
	print_wifi(sh, st.wifi, ssid);
	print_broker(sh, &broker, &st);
	if (running != NULL) {
		shell_print(sh, "Image: slot %d %s %s", running->slot, running->version,
			    running->confirmed ? "confirmed" : "not confirmed yet");
	} else {
		shell_print(sh, "Image: unknown");
	}
	if (st.reboot_pending) {
		shell_print(sh, "Reboot pending");
	}
	return 0;
}

static int cmd_image_list(const struct shell *sh, size_t argc, char **argv)
{
	ARG_UNUSED(argc);
	ARG_UNUSED(argv);

	struct image_adapter_slot slots[IMAGE_ADAPTER_SLOTS];
	size_t count = image_adapter_list(slots);

	for (size_t i = 0; i < count; i++) {
		const struct image_adapter_slot *s = &slots[i];
		char hash[2 * IMAGE_ADAPTER_HASH_LEN + 1];

		for (size_t j = 0; j < IMAGE_ADAPTER_HASH_LEN; j++) {
			snprintf(&hash[2 * j], 3, "%02x", s->hash[j]);
		}
		shell_print(sh, "Slot %d: %s%s%s%s%s", s->slot, s->version,
			    s->active ? " active" : "", s->confirmed ? " confirmed" : "",
			    s->pending ? " pending" : "", s->permanent ? " permanent" : "");
		shell_print(sh, "  hash %s", hash);
	}
	if (count == 0) {
		shell_print(sh, "No images found");
	}
	return 0;
}

SHELL_STATIC_SUBCMD_SET_CREATE(image_cmds,
	SHELL_CMD_ARG(list, NULL, "List the images in both slots and their state", cmd_image_list,
		      1, 0),
	SHELL_SUBCMD_SET_END);

SHELL_STATIC_SUBCMD_SET_CREATE(name_cmds,
	SHELL_CMD_ARG(set, NULL, "Set the friendly name: set <name>", cmd_name_set, 2, 0),
	SHELL_CMD_ARG(clear, NULL, "Clear the friendly name", cmd_name_clear, 1, 0),
	SHELL_SUBCMD_SET_END);

SHELL_STATIC_SUBCMD_SET_CREATE(broker_cmds,
	SHELL_CMD_ARG(set, NULL, "Set the Broker: set <host> [port, default 1883]",
		      cmd_broker_set, 2, 1),
	SHELL_CMD_ARG(login, NULL, "Log in to the Broker: login <username> [password]",
		      cmd_broker_login, 2, 1),
	SHELL_CMD_ARG(logout, NULL, "Connect to the Broker anonymously", cmd_broker_logout, 1,
		      0),
	SHELL_CMD_ARG(clear, NULL, "Forget the Broker", cmd_broker_clear, 1, 0),
	SHELL_CMD_ARG(show, NULL, "Show the Broker settings (password hidden) and connection",
		      cmd_broker_show, 1, 0),
	SHELL_SUBCMD_SET_END);

SHELL_STATIC_SUBCMD_SET_CREATE(network_cmds,
	SHELL_CMD_ARG(add, NULL, "Add a Known Network: add <ssid> [password]",
		      cmd_network_add, 2, 1),
	SHELL_CMD_ARG(remove, NULL, "Remove a Known Network: remove <ssid>",
		      cmd_network_remove, 2, 0),
	SHELL_CMD_ARG(list, NULL, "List Known Networks (passwords hidden)", cmd_network_list, 1,
		      0),
	SHELL_CMD_ARG(status, NULL, "Show the current Known Network, RSSI and IP address",
		      cmd_network_status, 1, 0),
	SHELL_SUBCMD_SET_END);

SHELL_STATIC_SUBCMD_SET_CREATE(node_cmds,
	SHELL_CMD_ARG(status, NULL, "Show everything about the Node's state at a glance",
		      cmd_node_status, 1, 0),
	SHELL_CMD_ARG(version, NULL, "Print the firmware version", cmd_node_version, 1, 0),
	SHELL_CMD_ARG(id, NULL, "Print the Node ID, friendly name and mDNS name", cmd_node_id, 1, 0),
	SHELL_CMD(name, &name_cmds, "Friendly name", NULL),
	SHELL_CMD(network, &network_cmds, "Known Networks", NULL),
	SHELL_CMD(broker, &broker_cmds, "Broker connection", NULL),
	SHELL_CMD(image, &image_cmds, "Firmware images", NULL),
	SHELL_SUBCMD_SET_END);

SHELL_CMD_REGISTER(node, &node_cmds, "Node commands", NULL);
```
